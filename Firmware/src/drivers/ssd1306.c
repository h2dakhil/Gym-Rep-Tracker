#include "ssd1306.h"
#include "i2c_bus.h"
#include <string.h>

// SSD1306 Commands
#define SSD1306_DISPLAYOFF          0xAE
#define SSD1306_SETDISPLAYCLOCKDIV  0xD5
#define SSD1306_SETMULTIPLEX        0xA8
#define SSD1306_SETDISPLAYOFFSET    0xD3
#define SSD1306_SETSTARTLINE        0x40
#define SSD1306_CHARGEPUMP          0x8D
#define SSD1306_MEMORYMODE          0x20
#define SSD1306_SEGREMAP            0xA0
#define SSD1306_COMSCANDEC          0xC8
#define SSD1306_SETCOMPINS          0xDA
#define SSD1306_SETCONTRAST         0x81
#define SSD1306_SETPRECHARGE        0xD9
#define SSD1306_SETVCOMDETECT       0xDB
#define SSD1306_DISPLAYALLON_RESUME 0xA4
#define SSD1306_NORMALDISPLAY       0xA6
#define SSD1306_DISPLAYON           0xAF

// Simple 6x8 font (basic ASCII characters)
static const uint8_t font_6x8[][6] = {
    {0x00, 0x00, 0x00, 0x00, 0x00, 0x00}, // Space
    {0x00, 0x00, 0x5F, 0x00, 0x00, 0x00}, // !
    {0x00, 0x07, 0x00, 0x07, 0x00, 0x00}, // "
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    {0x10, 0x08, 0x08, 0x10, 0x08, 0x00}, // ~
};

/**
 * @brief Sends a command to the SSD1306 display.
 */
static void ssd1306_command(uint8_t cmd)
{
    uint8_t buffer[2] = {0x00, cmd}; // 0x00 = command mode
    i2c_mem_write(SSD1306_I2C_ADDR, 0x00, buffer, 2);
}

/**
 * @brief Sends data to the SSD1306 display.
 */
static void ssd1306_data(uint8_t data)
{
    uint8_t buffer[2] = {0x40, data}; // 0x40 = data mode
    i2c_mem_write(SSD1306_I2C_ADDR, 0x00, buffer, 2);
}

/**
 * @brief Initializes the SSD1306 OLED display.
 */
HAL_StatusTypeDef ssd1306_init(void)
{
    // Initialize display
    ssd1306_command(SSD1306_DISPLAYOFF);
    ssd1306_command(SSD1306_SETDISPLAYCLOCKDIV);
    ssd1306_command(0x80);
    ssd1306_command(SSD1306_SETMULTIPLEX);
    ssd1306_command(0x1F); // 32 rows
    ssd1306_command(SSD1306_SETDISPLAYOFFSET);
    ssd1306_command(0x00);
    ssd1306_command(SSD1306_SETSTARTLINE | 0x00);
    ssd1306_command(SSD1306_CHARGEPUMP);
    ssd1306_command(0x14);
    ssd1306_command(SSD1306_MEMORYMODE);
    ssd1306_command(0x00);
    ssd1306_command(SSD1306_SEGREMAP | 0x1);
    ssd1306_command(SSD1306_COMSCANDEC);
    ssd1306_command(SSD1306_SETCOMPINS);
    ssd1306_command(0x02);
    ssd1306_command(SSD1306_SETCONTRAST);
    ssd1306_command(0xCF);
    ssd1306_command(SSD1306_SETPRECHARGE);
    ssd1306_command(0xF1);
    ssd1306_command(SSD1306_SETVCOMDETECT);
    ssd1306_command(0x40);
    ssd1306_command(SSD1306_DISPLAYALLON_RESUME);
    ssd1306_command(SSD1306_NORMALDISPLAY);
    ssd1306_command(SSD1306_DISPLAYON);

    // Clear display
    ssd1306_clear();
    
    return HAL_OK;
}

/**
 * @brief Clears the entire display.
 */
void ssd1306_clear(void)
{
    for (uint8_t page = 0; page < 4; page++) // 4 pages for 32px height
    {
        ssd1306_command(0xB0 + page); // Set page address
        ssd1306_command(0x02);        // Set lower column address
        ssd1306_command(0x10);        // Set higher column address
        
        for (uint8_t col = 0; col < 128; col++)
        {
            ssd1306_data(0x00);
        }
    }
}

/**
 * @brief Draws a character string at the specified (x, y) position.
 */
void ssd1306_draw_text(uint8_t x, uint8_t y, const char* text)
{
    uint8_t len = strlen(text);
    
    for (uint8_t i = 0; i < len; i++)
    {
        char c = text[i];
        if (c >= 32 && c <= 126) // Printable ASCII characters
        {
            uint8_t char_index = c - 32;
            
            // Set position
            ssd1306_command(0xB0 + y);           // Set page address
            ssd1306_command(0x02 + (x & 0x0F));  // Set lower column address
            ssd1306_command(0x10 + ((x >> 4) & 0x0F)); // Set higher column address
            
            // Draw character
            for (uint8_t col = 0; col < 6; col++)
            {
                ssd1306_data(font_6x8[char_index][col]);
            }
            
            x += 6; // Move to next character position
        }
    }
}

/**
 * @brief Updates the display (for 128x32, this is immediate).
 */
void ssd1306_update(void)
{
    // For 128x32 display, data is written immediately to GRAM
    // No framebuffer needed
}

